## boards/shields/custom54/Kconfig.defconfig
```kconfig
if SHIELD_CUSTOM54_LEFT

config ZMK_KEYBOARD_NAME
    default "Custom 54"

config ZMK_SPLIT_ROLE_CENTRAL
    default y

endif # SHIELD_CUSTOM54_LEFT

if SHIELD_CUSTOM54_LEFT || SHIELD_CUSTOM54_RIGHT

config ZMK_SPLIT
    default y

endif # SHIELD_CUSTOM54_LEFT || SHIELD_CUSTOM54_RIGHT
```

## boards/shields/custom54/Kconfig.shield
```kconfig
config SHIELD_CUSTOM54_LEFT
    def_bool $(shields_list_contains,custom54_left)

config SHIELD_CUSTOM54_RIGHT
    def_bool $(shields_list_contains,custom54_right)
```
